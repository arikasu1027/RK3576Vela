## bsp/nuttx-boards/arm64/rk3576/kickpi-k7/Kconfig
```kconfig
#
# For a description of the syntax of this configuration file,
# see the file kconfig-language.txt in the NuttX tools repository.
#

if ARCH_BOARD_KICKPI_K7

menu "KICKPI-K7 Board Selection"

config BOARD_LATE_INITIALIZE
	bool "Late initialization"
	default y

config BOARD_LOOPSPERMSEC
	int "Loops per millisecond"
	default 16800000

config ARCH_CHIP
	string
	default "rk3576" if ARCH_CHIP_RK3576

config ARCH_BOARD
	string
	default "kickpi-k7"

endmenu # KICKPI-K7 Board Selection

endif # ARCH_BOARD_KICKPI_K7
```
